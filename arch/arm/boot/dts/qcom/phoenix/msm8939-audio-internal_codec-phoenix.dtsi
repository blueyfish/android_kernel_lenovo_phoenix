/* Copyright (c) 2015, The Linux Foundation. All rights reserved.
 *
 * This program is free software; you can redistribute it and/or modify
 * it under the terms of the GNU General Public License version 2 and
 * only version 2 as published by the Free Software Foundation.
 *
 * This program is distributed in the hope that it will be useful,
 * but WITHOUT ANY WARRANTY; without even the implied warranty of
 * MERCHANTABILITY or FITNESS FOR A PARTICULAR PURPOSE.  See the
 * GNU General Public License for more details.
 */

&soc {
	sound {
		qcom,model = "msm8939-snd-card-skuk";
		qcom,msm-mbhc-hphl-swh = <1>;
		qcom,audio-routing =
			"RX_BIAS", "MCLK",
			"SPK_RX_BIAS", "MCLK",
			"INT_LDO_H", "MCLK",
			"MIC BIAS External", "Digital Mic1",
			"MIC BIAS Internal2", "Headset Mic",
			"MIC BIAS External", "Digital Mic2",
			"DMIC1", "MIC BIAS External",
			"AMIC2", "MIC BIAS Internal2",
			"DMIC2", "MIC BIAS External";
		pinctrl-names = "cdc_lines_act",
				"cdc_lines_sus";
		pinctrl-0 = <&cdc_pdm_lines_act &cdc_dmic_lines_act>;
		pinctrl-1 = <&cdc_pdm_lines_sus &cdc_dmic_lines_sus>;
		/delete-property/ pinctrl-2;
		/delete-property/ pinctrl-3;
		/delete-property/ qcom,cdc-us-euro-gpios;
	};
};
