## drivers/input/touchscreen/gt9xx_qc/Kconfig
```kconfig
#
# Goodix GT9xx Touchscreen driver
#

config GT9XX_TOUCHPANEL_QC_DRIVER
	tristate "Goodix GT9xx touchpanel (Qunchuang variant) driver"
	depends on TOUCHSCREEN_GT9XX_QC
	default n
	help
	  This is the main file for touchpanel driver for Goodix GT9xx
	  touchscreens.

	  Say Y here if you have a Goodix GT9xx touchscreen connected
	  to your system.

	  If unsure, say N.

	  To compile this driver as a module, choose M here: the
	  module will be called gt9xx_update.

config GT9XX_TOUCHPANEL_QC_UPDATE
	tristate "Goodix GT9xx touchpanel (Qunchuang variant) auto update support"
	depends on GT9XX_TOUCHPANEL_QC_DRIVER
	default n
	help
	  This enables support for firmware update for Goodix GT9xx
	  touchscreens.

	  Say Y here if you have a Goodix GT9xx touchscreen connected
	  to your system.

	  If unsure, say N.

	  To compile this driver as a module, choose M here: the
	  module will be called gt9xx_update.

config GT9XX_TOUCHPANEL_QC_DEBUG
	tristate "Goodix GT9xx (Qunchuang variant) Tools for debuging"
	depends on GT9XX_TOUCHPANEL_QC_DRIVER
	default n
	help
	  This is application debug interface support for Goodix GT9xx
	  touchscreens.

	  Say Y here if you want to have a Android app debug interface
	  to your system.

	  If unsure, say N.

	  To compile this driver as a module, choose M here: the
	  module will be called gt9xx_update.
```

## drivers/platform/lenovo/Kconfig
```kconfig
# Lenovo configuration options

config MACH_LENOVO
	bool "Lenovo device"
	depends on ARCH_MSM
	help
	  Support for Lenovo products

config MACH_LENOVO_PHAB
	bool "Lenovo PHAB"
	depends on ARCH_MSM8916
	select MACH_LENOVO
	help
	  Support for Lenovo PHAB variants

menu "Lenovo board selection"

config MACH_PHOENIX
	bool "phoenix board"
	select MACH_LENOVO_PHAB
	help
	  Support for the phoenix variants

endmenu
```
